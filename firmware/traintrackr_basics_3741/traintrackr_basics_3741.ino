/* *************************
 *  Traintrackr Basics when using the IS31Fl3741 LED driver chip
 *  traintrackr.io
 *  Richard Hawthorn
 *  2022-04-20
 */

#include <Wire.h>

//setup brightness
int brightness = 16;

//setup mapping
const PROGMEM byte led_3741_gama64[64]= {
  0x00,0x01,0x02,0x03,0x04,0x05,0x06,0x07,
  0x08,0x09,0x0b,0x0d,0x0f,0x11,0x13,0x16,
  0x1a,0x1c,0x1d,0x1f,0x22,0x25,0x28,0x2e,
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  0xe1,0xe9,0xed,0xf1,0xf6,0xfa,0xfe,0xff
};

const PROGMEM byte led_3741_map[117]= {
  0x62,0x6B,0x74,0x7D,0x86,0x8F,0x98,0xA1,0xAA,
  0x5F,0x68,0x71,0x7A,0x83,0x8C,0x95,0x9E,0xA7,
  0x5C,0x65,0x6E,0x77,0x80,0x89,0x92,0x9B,0xA4,
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  0x02,0x20,0x3E,0x5C,0x7A,0x98,0x02,0x20,0x3E,
};

const PROGMEM byte led_3741_page[117]= {
  0x01,0x01,0x01,0x01,0x01,0x01,0x01,0x01,0x01,
  0x01,0x01,0x01,0x01,0x01,0x01,0x01,0x01,0x01,
  0x01,0x01,0x01,0x01,0x01,0x01,0x01,0x01,0x01,
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  0x00,0x00,0x00,0x00,0x00,0x00,0x01,0x01,0x01,
};





void write_to_3741(uint8_t Dev_Add, uint8_t Reg_Add, uint8_t Reg_Dat)
{
  Wire.beginTransmission(Dev_Add/2); // transmit to device
  Wire.write(Reg_Add); // sends regaddress
  Wire.write(Reg_Dat); // sends data
  Wire.endTransmission(); // stop transmitting
}

void set_brightness_3741(uint8_t chip_addr, int brightness){

  //scale up to 256, go for the mid range of that brightness level
  brightness = (brightness * 16) - 10;

  //make sure we don't go higher than 256
  brightness = min(brightness, 256);

  //or lower than 1
  brightness = max(brightness, 1);

  write_to_3741(chip_addr,0xfe,0xc5);//unlock
  write_to_3741(chip_addr,0xfD,0x02);//write page 2 - scaling for first set of leds
  for(int i=2;i<0xB4;i+=3)
  {
    write_to_3741(chip_addr,i,brightness);//R LED Scaling - scale brightness based on max Rdata value
  }
  for(int i=1;i<0xB4;i+=3)
  {
    write_to_3741(chip_addr,i,brightness);//G LED Scaling
  }
  for(int i=0;i<0xB4;i+=3)
  {
    write_to_3741(chip_addr,i,brightness);//B LED Scaling
  }
  write_to_3741(chip_addr,0xfe,0xc5);//unlock
  write_to_3741(chip_addr,0xfD,0x03);//write page 3 - scaling for second set of leds
  for(int i=2;i<0xAB;i+=3)
  {
    write_to_3741(chip_addr,i,brightness);//R LED Scaling
  }
  for(int i=1;i<0xAB;i+=3)
  {
    write_to_3741(chip_addr,i,brightness);//G LED Scaling
  }
  for(int i=0;i<0xAB;i+=3)
  {
    write_to_3741(chip_addr,i,brightness);//B LED Scaling
  }
  
}

void set_off_3741(uint8_t chip_addr){
  
  write_to_3741(chip_addr,0xfe,0xc5);//unlock
  write_to_3741(chip_addr,0xfD,0x00);//write page 0 - pwm (brightness) for first set of leds
  for(int i=0;i<0xB4;i++)
  {
    write_to_3741(chip_addr,i,0x00);//write all PWM set 0x00 - turn off
  }
  write_to_3741(chip_addr,0xfe,0xc5);//unlock
  write_to_3741(chip_addr,0xfD,0x01);//write page 1  - pwm (brightness) for first set of leds
  for(int i=0;i<0xAB;i++)
  {
    write_to_3741(chip_addr,i,0x00);//write all PWM set 0x00 - turn off
  } //init all the PWM data to 0
  
}


void setup_3741(uint8_t chip_addr, int brightness)
{

  set_brightness_3741(chip_addr, brightness);
  set_off_3741(chip_addr);
  
  //adjust 3741 config
  write_to_3741(chip_addr,0xfe,0xc5);//unlock
  write_to_3741(chip_addr,0xfD,0x04);//write page 4
  write_to_3741(chip_addr,0x01,0x7F);//global current
  write_to_3741(chip_addr,0x00,0x01);//normal operation
}


void update_3741_rgb(int led, int r, int g, int b)
{

  int led_chip = 0;
  int led_address = 0;
  int led_position = 0;

 if (led >= 234){
    led_chip = 3;
    led_address = 0x64;
    led_position = led - 234;
  } else if (led >= 117){
    led_chip = 2;
    led_address = 0x62;
    led_position = led - 117;
  } else {
    led_chip = 1;
    led_address = 0x60;
    led_position = led;
  }

  r = min(r, 63);
  g = min(g, 63);
  b = min(b, 63);

  int led_page = pgm_read_byte_near(&led_3741_page[led_position]);
  
  int led_r = pgm_read_byte_near(&led_3741_map[led_position]);
  int led_g = pgm_read_byte_near(&led_3741_map[led_position]) - 1;
  int led_b = pgm_read_byte_near(&led_3741_map[led_position]) - 2;

  //gamma adjust, 0-64 -> 0-256
  r = pgm_read_byte_near(&led_3741_gama64[r]);
  g = pgm_read_byte_near(&led_3741_gama64[g]);
  b = pgm_read_byte_near(&led_3741_gama64[b]);

  //write the data  
  write_to_3741(led_address,0xFE,0xC5); //unlock
  write_to_3741(led_address,0xfD,led_page); //write to correct page
  
  write_to_3741(led_address,led_r, r); //write r pwm value
  write_to_3741(led_address,led_g, g); //write g pwm value
  write_to_3741(led_address,led_b, b); //write b pwm value
  

}

void setup() {
  Serial.begin(115200);
  Serial.println("Traintrackr Basics 3741");

  //enable wire
  Wire.begin();
  Wire.setClock(1000000);

  //setup chips
  setup_3741(0x60, brightness);
  setup_3741(0x62, brightness);
  setup_3741(0x64, brightness);

}

void loop() {

  //turn on the first LED 
  update_3741_rgb(0, 32, 32, 32);

  //wait a second
  delay(1000);

  //turn off the LED
  update_3741_rgb(0, 0, 0, 0);

  //wait a second
  delay(1000);  

}
